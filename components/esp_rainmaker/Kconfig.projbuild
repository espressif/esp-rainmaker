## examples/common/rmaker_user_api/example/rmaker_user_api/main/Kconfig.projbuild
```kconfig
menu "Example Configuration"

    choice
        prompt "RainMaker login method"
        default EXAMPLE_RAINMAKER_LOGIN_REFRESH_TOKEN
        help
            Select the method for RainMaker login authentication.

        config EXAMPLE_RAINMAKER_LOGIN_REFRESH_TOKEN
            bool "Use refresh token"

        config EXAMPLE_RAINMAKER_LOGIN_USERNAME_PASSWORD
            bool "Use username and password"
    endchoice

    config EXAMPLE_RAINMAKER_USERNAME
        string "RainMaker username"
        default ""
        depends on EXAMPLE_RAINMAKER_LOGIN_USERNAME_PASSWORD
        help
            Email (username) for RainMaker. Only used if 'username and password' is chosen.

    config EXAMPLE_RAINMAKER_PASSWORD
        string "RainMaker password"
        default ""
        depends on EXAMPLE_RAINMAKER_LOGIN_USERNAME_PASSWORD
        help
            Password for RainMaker. Only used if 'username and password' is chosen.

    config EXAMPLE_RAINMAKER_REFRESH_TOKEN
        string "RainMaker refresh token"
        default ""
        depends on EXAMPLE_RAINMAKER_LOGIN_REFRESH_TOKEN
        help
            Refresh token for RainMaker. Only used if 'refresh token' is chosen.
            The way to get refresh token, please refer to README.

    config EXAMPLE_RAINMAKER_BASE_URL
        string "RainMaker API base endpoint url"
        default "https://api.rainmaker.espressif.com"
        help
            The default RainMaker cloud base URL to communicate
endmenu
```

## examples/common/rmaker_user_api/example/rmaker_user_api/sdkconfig.defaults
```kconfig
# Compiler options
CONFIG_COMPILER_CXX_EXCEPTIONS=y
CONFIG_COMPILER_CXX_EXCEPTIONS_EMG_POOL_SIZE=1024
CONFIG_COMPILER_OPTIMIZATION_SIZE=y

# mbedtls
CONFIG_MBEDTLS_DYNAMIC_BUFFER=y
CONFIG_MBEDTLS_DYNAMIC_FREE_PEER_CERT=y
CONFIG_MBEDTLS_DYNAMIC_FREE_CONFIG_DATA=y
CONFIG_MBEDTLS_CERTIFICATE_BUNDLE_DEFAULT_CMN=y

CONFIG_ESP_MAIN_TASK_STACK_SIZE=10240

#
# Partition Table
#
# CONFIG_PARTITION_TABLE_SINGLE_APP is not set
CONFIG_PARTITION_TABLE_SINGLE_APP_LARGE=y
# CONFIG_PARTITION_TABLE_TWO_OTA is not set
# CONFIG_PARTITION_TABLE_TWO_OTA_LARGE is not set
# CONFIG_PARTITION_TABLE_CUSTOM is not set
CONFIG_PARTITION_TABLE_CUSTOM_FILENAME="partitions.csv"
CONFIG_PARTITION_TABLE_FILENAME="partitions_singleapp_large.csv"
CONFIG_PARTITION_TABLE_OFFSET=0x8000
CONFIG_PARTITION_TABLE_MD5=y
# end of Partition Table

CONFIG_ENABLE_RM_USER_HELPER_API=y
```

## examples/ethernet_switch/components/app_ethernet/Kconfig.projbuild
```kconfig
menu "Example Ethernet Configuration"

    choice EXAMPLE_ETH_PHY_INTERFACE
        prompt "PHY interface"
        default EXAMPLE_ETH_PHY_INTERFACE_DEFAULT
        help
            Select the communication interface between MAC and PHY chip.

        config EXAMPLE_ETH_PHY_INTERFACE_DEFAULT
            bool "Default EMAC interface configuration"
            help
                Will use default hardcoded ESP Ethernet MAC driver configuration

        config EXAMPLE_ETH_PHY_INTERFACE_RMII
            bool "Reduced Media Independent Interface (RMII)"
    endchoice

    if EXAMPLE_ETH_PHY_INTERFACE_RMII
        choice EXAMPLE_ETH_RMII_CLK_MODE
            prompt "RMII CLK mode"
            default EXAMPLE_ETH_RMII_CLK_INPUT
            help
                Select external or internal RMII CLK.

            config EXAMPLE_ETH_RMII_CLK_INPUT
                bool "Input RMII CLK from external"
                help
                    MAC will get RMII CLK from outside.

            config EXAMPLE_ETH_RMII_CLK_OUTPUT
                bool "Output RMII CLK from internal"
                help
                    Generate RMII CLK by internal PLL.
                    This clock can be routed to the external PHY device.
                    !! WARNING !!
                    ESP32 Errata: If you want the Ethernet to work with WiFi or BT, don't select ESP32
                    as RMII CLK output as it would result in clock instability! Applicable only to ESP32,
                    other ESP32 SoCs (like ESP32P4) are not affected.
        endchoice

        config EXAMPLE_ETH_RMII_CLK_GPIO
            int "RMII CLK GPIO"
            default 50 if IDF_TARGET_ESP32P4
            default 0
            help
                RMII CLK input or output GPIO. See datasheet for available GPIOs.

        config EXAMPLE_ETH_RMII_CLK_EXT_LOOPBACK_EN
            depends on !SOC_EMAC_RMII_CLK_OUT_INTERNAL_LOOPBACK && EXAMPLE_ETH_RMII_CLK_OUTPUT
            bool "Enable external RMII CLK loopback input"
            default y
            help
                RMII CLK output signal must be looped back to the EMAC externally on certain chips.

        config EXAMPLE_ETH_RMII_CLK_EXT_LOOPBACK_IN_GPIO
            depends on EXAMPLE_ETH_RMII_CLK_EXT_LOOPBACK_EN
            int "RMII CLK loopback input GPIO"
            default 32 if IDF_TARGET_ESP32P4
            default 0
            help
                Set GPIO number used by RMII REF CLK input to loopback internally generated RMII CLK output.
                See datasheet for available GPIOs.

        if SOC_EMAC_USE_MULTI_IO_MUX
            config EXAMPLE_ETH_RMII_TX_EN_GPIO
                int "RMII TX_EN GPIO number"
                default 49 if IDF_TARGET_ESP32P4
                default 0
                help
                    Set the GPIO number used by RMII TX_EN signal.
                    See datasheet for available GPIOs.

            config EXAMPLE_ETH_RMII_TXD0_GPIO
                int "RMII TXD0 GPIO number"
                default 34 if IDF_TARGET_ESP32P4
                default 0
                help
                    Set the GPIO number used by RMII TXD0 signal.
                    See datasheet for available GPIOs.

            config EXAMPLE_ETH_RMII_TXD1_GPIO
                int "RMII TXD1 GPIO number"
                default 35 if IDF_TARGET_ESP32P4
                default 0
                help
                    Set the GPIO number used by RMII TXD1 signal.
                    See datasheet for available GPIOs.

            config EXAMPLE_ETH_RMII_CRS_DV_GPIO
                int "RMII CRS_DV GPIO number"
                default 28 if IDF_TARGET_ESP32P4
                default 0
                help
                    Set the GPIO number used by RMII CRS_DV signal.
                    See datasheet for available GPIOs.

            config EXAMPLE_ETH_RMII_RXD0_GPIO
                int "RMII RXD0 GPIO number"
                default 29 if IDF_TARGET_ESP32P4
                default 0
                help
                    Set the GPIO number used by RMII RXD0 signal.
                    See datasheet for available GPIOs.

            config EXAMPLE_ETH_RMII_RXD1_GPIO
                int "RMII RXD1 GPIO number"
                default 30 if IDF_TARGET_ESP32P4
                default 0
                help
                    Set the GPIO number used by RMII RXD1 signal.
                    See datasheet for available GPIOs.

        endif

    endif

    config EXAMPLE_ETH_MDC_GPIO
        int "SMI MDC GPIO number"
        default 23 if IDF_TARGET_ESP32
        default 31 if IDF_TARGET_ESP32P4
        help
            Set the GPIO number used by SMI MDC.

    config EXAMPLE_ETH_MDIO_GPIO
        int "SMI MDIO GPIO number"
        default 18 if IDF_TARGET_ESP32
        default 52 if IDF_TARGET_ESP32P4
        help
            Set the GPIO number used by SMI MDIO.

    config EXAMPLE_ETH_PHY_ADDR
        int "PHY Address"
        range -1 31
        default 1
        help
            Set PHY address according your board schematic.
            Set to -1 to driver find the PHY address automatically.

    config EXAMPLE_ETH_PHY_RST_GPIO
        int "PHY Reset GPIO number"
        default 5 if IDF_TARGET_ESP32
        default 51 if IDF_TARGET_ESP32P4
        help
            Set the GPIO number used to reset PHY chip.
            Set to -1 to disable PHY chip hardware reset.

    menuconfig EXAMPLE_ETH_PHY_RST_TIMING_EN
        bool "PHY Reset Timing configuration"
        default n
        help
            Default reset timing configuration is set conservatively. If you need faster response and
            your chip supports it, enable and configure it. See PHY datasheet "AC Specification" section.

    config EXAMPLE_ETH_PHY_RST_ASSERT_TIME_US
        int "PHY Reset Assert Time (microseconds)"
        depends on EXAMPLE_ETH_PHY_RST_TIMING_EN
        range 0 100000
        default 10000
        help
            Time in microseconds to assert the PHY reset signal.
            This should be long enough to ensure the PHY chip is properly reset.

    config EXAMPLE_ETH_PHY_RST_DELAY_MS
        int "PHY Post-Reset Delay (milliseconds)"
        depends on EXAMPLE_ETH_PHY_RST_TIMING_EN
        range -1 4000
        default 10
        help
            Delay in milliseconds after releasing the PHY reset signal.
            This allows the PHY chip to stabilize before communication begins.
            When no delay required, set -1.

endmenu
```

## examples/ethernet_switch/sdkconfig.defaults
```kconfig
CONFIG_ESPTOOLPY_FLASHSIZE_4MB=y

#
# Use partition table which makes use of flash to the fullest
# Can be used for other platforms as well. But please keep in mind that fctry partition address is
# different than default, and the new address needs to be specified to `rainmaker.py claim`
#
CONFIG_PARTITION_TABLE_CUSTOM=y
CONFIG_PARTITION_TABLE_CUSTOM_FILENAME="partitions_4mb_optimised.csv"

# To accomodate security features
CONFIG_PARTITION_TABLE_OFFSET=0xc000

# mbedtls
CONFIG_MBEDTLS_DYNAMIC_BUFFER=y
CONFIG_MBEDTLS_DYNAMIC_FREE_PEER_CERT=y
CONFIG_MBEDTLS_DYNAMIC_FREE_CONFIG_DATA=y
CONFIG_MBEDTLS_CERTIFICATE_BUNDLE_DEFAULT_CMN=y

# Wi-Fi and Bluetooth configuration
# Set CONFIG_EXAMPLE_ENABLE_WIFI=y in menuconfig to enable Wi-Fi support
# When Wi-Fi is enabled, device can be provisioned via Wi-Fi OR use Ethernet
# Both networks can work simultaneously - RainMaker uses whichever connects first
CONFIG_BT_ENABLED=n
# CONFIG_ESP32_WIFI_ENABLED is controlled by EXAMPLE_ENABLE_WIFI Kconfig option
# CONFIG_ESP_RMAKER_NETWORK_OVER_WIFI is automatically set when Wi-Fi is enabled

# Disable MQTT username (PPI string) to avoid MAC address fetching issues
CONFIG_ESP_RMAKER_MQTT_SEND_USERNAME=n

# Temporary Fix for Timer Overflows
CONFIG_FREERTOS_TIMER_TASK_STACK_DEPTH=3120

# Claiming not supported for Ethernet
CONFIG_ESP_RMAKER_NO_CLAIM=y

# Enable parameter console commands
CONFIG_ESP_RMAKER_CONSOLE_PARAM_CMDS_ENABLE=y

# Application Rollback
CONFIG_BOOTLOADER_APP_ROLLBACK_ENABLE=y

# Secure Local Control : Will also be used for User-Node Mapping via Challenge - Response
CONFIG_ESP_RMAKER_LOCAL_CTRL_AUTO_ENABLE=y
CONFIG_EXAMPLE_LOCAL_CTRL_POP="abcd1234"
CONFIG_ESP_RMAKER_LOCAL_CTRL_SECURITY_1=y
CONFIG_ESP_RMAKER_ENABLE_CHALLENGE_RESPONSE=y
CONFIG_ESP_RMAKER_LOCAL_CTRL_CHAL_RESP_ENABLE=y


# Enable Ethernet
CONFIG_ETH_ENABLED=y

# Enable asynchronous network connection for dual-network support
# This allows Wi-Fi and Ethernet to connect simultaneously, improving startup time
CONFIG_APP_NETWORK_ASYNCHRONOUS_CONNECTION=y

# ============================================================================
# Size Optimization Settings
# ============================================================================
# These options help reduce IRAM and binary size while maintaining functionality

# Compiler Optimization - Optimize for size
CONFIG_COMPILER_OPTIMIZATION_SIZE=y

# Reduce assertion check overhead
CONFIG_COMPILER_OPTIMIZATION_CHECKS_SILENT=y

# IRAM Optimizations - Safe options that don't affect functionality
# Move FreeRTOS functions to flash (safe if not used from ISRs)
CONFIG_FREERTOS_PLACE_FUNCTIONS_INTO_FLASH=y

# Move ring buffer functions to flash (safe if not used from ISRs)
CONFIG_RINGBUF_PLACE_FUNCTIONS_INTO_FLASH=y

# Move heap functions to flash (safe if SPI_MASTER_ISR_IN_IRAM is disabled)
CONFIG_HEAP_PLACE_FUNCTION_INTO_FLASH=y

# Disable libc locks in IRAM (safe if no ISRs use libc locks while cache disabled)
CONFIG_LIBC_LOCKS_PLACE_IN_IRAM=n
```

## examples/fan/main/Kconfig.projbuild
```kconfig
menu "Example Configuration"

    config EXAMPLE_BOARD_BUTTON_GPIO
        int "Boot Button GPIO"
        default 28 if IDF_TARGET_ESP32C5
        default 9 if IDF_TARGET_ESP32C3 || IDF_TARGET_ESP32C6 || IDF_TARGET_ESP32C2 || IDF_TARGET_ESP32H2
        default 0
        help
            GPIO number on which the "Boot" button is connected. This is generally used
            by the application for custom operations like toggling states, resetting to defaults, etc.

    choice LED_TYPE
        prompt "LED Type"
        default LED_TYPE_RGB if IDF_TARGET_ESP32C2
        default LED_TYPE_NONE if IDF_TARGET_ESP32
        default LED_TYPE_WS2812
        help
            Select the type of LED to use.

        config LED_TYPE_RGB
            bool "RGB LED (3-pin RGB LED)"
            help
                Use a 3-pin RGB LED with separate GPIO pins for red, green, and blue.

        config LED_TYPE_WS2812
            bool "WS2812 LED Strip"
            help
                Use WS2812 addressable LED strip.

        config LED_TYPE_NONE
            bool "No LED"
            help
                Disable LED hardware. Useful for testing without LED hardware connected.
    endchoice

    config RGB_LED_RED_GPIO
        int "RGB LED Red GPIO"
        default 0
        depends on LED_TYPE_RGB
        help
            GPIO number for the red channel of the RGB LED.

    config RGB_LED_GREEN_GPIO
        int "RGB LED Green GPIO"
        default 1
        depends on LED_TYPE_RGB
        help
            GPIO number for the green channel of the RGB LED.

    config RGB_LED_BLUE_GPIO
        int "RGB LED Blue GPIO"
        default 8
        depends on LED_TYPE_RGB
        help
            GPIO number for the blue channel of the RGB LED.

    config RGB_LED_ACTIVE_LEVEL_HIGH
        bool "RGB LED Active Level High"
        default n
        depends on LED_TYPE_RGB
        help
            Set to y if the RGB LED is active high (common cathode), n if active low (common anode).

    config WS2812_LED_GPIO
        int "WS2812 LED GPIO"
        default 27 if IDF_TARGET_ESP32C5
        default 8 if IDF_TARGET_ESP32C3 || IDF_TARGET_ESP32C6 || IDF_TARGET_ESP32H2
        default 48 if IDF_TARGET_ESP32S3
        default 18
        depends on LED_TYPE_WS2812
        help
            GPIO number for the WS2812 RGB LED strip.

    config WS2812_LED_COUNT
        int "Number of WS2812 LEDs"
        default 1
        range 1 256
        depends on LED_TYPE_WS2812
        help
            Number of LEDs in the WS2812 strip.
endmenu
```

## examples/fan/sdkconfig.defaults
```kconfig
CONFIG_ESPTOOLPY_FLASHSIZE_4MB=y
CONFIG_PARTITION_TABLE_SINGLE_APP=
CONFIG_PARTITION_TABLE_TWO_OTA=
CONFIG_PARTITION_TABLE_CUSTOM=y
CONFIG_PARTITION_TABLE_CUSTOM_FILENAME="partitions.csv"
CONFIG_PARTITION_TABLE_FILENAME="partitions.csv"
CONFIG_PARTITION_TABLE_OFFSET=0x8000
CONFIG_PARTITION_TABLE_MD5=y

# mbedtls
CONFIG_MBEDTLS_DYNAMIC_BUFFER=y
CONFIG_MBEDTLS_DYNAMIC_FREE_PEER_CERT=y
CONFIG_MBEDTLS_DYNAMIC_FREE_CONFIG_DATA=y

# For BLE Provisioning using NimBLE stack (Not applicable for ESP32-S2)
CONFIG_BT_ENABLED=y
CONFIG_BTDM_CTRL_MODE_BLE_ONLY=y
CONFIG_BT_NIMBLE_ENABLED=y

# Temporary Fix for Timer Overflows
CONFIG_FREERTOS_TIMER_TASK_STACK_DEPTH=3120
```
