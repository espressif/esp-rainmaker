## components/esp_rainmaker/test_app/sdkconfig.defaults
```kconfig
# Task watchdog: do not check idle task
CONFIG_ESP_TASK_WDT_CHECK_IDLE_TASK_CPU0=n
CONFIG_ESP_TASK_WDT_CHECK_IDLE_TASK_CPU1=n

# Run all tests on boot (no interactive menu)
CONFIG_UNIT_TEST_RUN_ALL_AUTO=y

# Unity test framework configuration
CONFIG_UNITY_ENABLE_FLOAT=y
CONFIG_UNITY_ENABLE_DOUBLE=y
CONFIG_UNITY_ENABLE_64BIT=y
CONFIG_UNITY_ENABLE_COLOR=y
CONFIG_UNITY_ENABLE_IDF_TEST_RUNNER=y
CONFIG_UNITY_ENABLE_FIXTURE=y
CONFIG_UNITY_ENABLE_BACKTRACE_ON_FAIL=y

# ESP RainMaker configuration
CONFIG_ESP_MAIN_TASK_STACK_SIZE=7168
CONFIG_ESP_RMAKER_TASK_STACK=4096
CONFIG_ESP_RMAKER_WORK_QUEUE_TASK_STACK=4096
CONFIG_ESP_RMAKER_WORK_QUEUE_TASK_PRIORITY=5

# ESP RainMaker component specific configuration
CONFIG_ESP_RMAKER_SELF_CLAIM=y
CONFIG_ESP_RMAKER_CLAIM_TYPE_RANDOM=y
# Disable challenge response so node init works when device has no claim data (CI/local without claim flash)
CONFIG_ESP_RMAKER_ENABLE_CHALLENGE_RESPONSE=n
CONFIG_ESP_RMAKER_MQTT_GLUE_ENABLED=y
CONFIG_ESP_RMAKER_LOCAL_CTRL_AUTO_ENABLE=y

# Compiler and partition table
CONFIG_COMPILER_OPTIMIZATION_DEFAULT=y
CONFIG_PARTITION_TABLE_CUSTOM=y
#CONFIG_PARTITION_TABLE_SINGLE_APP=y
CONFIG_ESPTOOLPY_FLASHSIZE_4MB=y
CONFIG_ESPTOOLPY_FLASHSIZE="4MB"
```

## components/esp_rmaker_console/Kconfig.projbuild
```kconfig
menu "ESP RainMaker Console Config"

    choice ESP_RMAKER_CONSOLE_UART_NUM
        prompt "UART for console input"
        default ESP_RMAKER_CONSOLE_UART_NUM_0
        help
            UART to be selected for serial console.

        config ESP_RMAKER_CONSOLE_UART_NUM_0
            bool "UART0"
        config ESP_RMAKER_CONSOLE_UART_NUM_1
            bool "UART1"
    endchoice

    config ESP_RMAKER_CONSOLE_UART_NUM
        int
        default 0 if ESP_RMAKER_CONSOLE_UART_NUM_0
        default 1 if ESP_RMAKER_CONSOLE_UART_NUM_1

endmenu
```

## components/esp_rmaker_core/Kconfig.projbuild
```kconfig
menu "ESP RainMaker Config"

config ESP_RMAKER_SELF_CLAIM
     bool "Use Self Claiming"
     depends on IDF_TARGET_ESP32S2
     default y
     help
        Use Self Claiming i.e. get the MQTT credentials
        directly from the claiming service.

config ESP_RMAKER_CLAIM_SERVICE_BASE_URL
    string "ESP RainMaker Claiming Service Base URL"
    default "https://esp-claiming.rainmaker.espressif.com"
    depends on ESP_RMAKER_SELF_CLAIM
    help
        ESP RainMaker Claiming Service Base URL.

config ESP_RMAKER_MQTT_HOST
    string "ESP RainMaker MQTT Host"
    depends on ESP_RMAKER_SELF_CLAIM
    default "a1p72mufdu6064-ats.iot.us-east-1.amazonaws.com"
    help
        ESP RainMaker MQTT Host name

config ESP_RMAKER_TASK_STACK
    int "ESP RainMaker Core Task stack"
    default 4096
    help
        Stack size for the ESP RainMaker Core Task. Atleast 10KB is required
        if you are using "Self Claiming"
        
config ESP_RMAKER_TASK_PRIORITY
    int "ESP RainMaker Core Task priority"
    default 5
    help
        Priority for the ESP RainMaker Core Task. Not recommended to be changed
        unless you really need it.

config ESP_RMAKER_MAX_NODE_CONFIG_SIZE
    int "Maximum Node Config size"
    default 2048
    range 512 65536
    help
        Maximum size of the payload for reporting Node configuration.

config ESP_RMAKER_MAX_PARAM_DATA_SIZE
    int "Maximum Parameters' data size"
    default 1024
    range 64 8192
    help
        Maximum size of the payload for reporting parameter values.

config ESP_RMAKER_FACTORY_PARTITION_NAME
    string "ESP RainMaker Factory Partition Name"
    default "fctry"
    help
        Factory NVS Partition name which will have the MQTT connectivity credentials

config ESP_RMAKER_SNTP_SERVER_NAME
    string "ESP RainMaker SNTP Server Name"
    default "pool.ntp.org"
    help
        Default SNTP Server which is used for time synchronization.

endmenu
```

## components/esp_rmaker_ota/Kconfig.projbuild
```kconfig
menu "ESP RainMaker OTA Config"

    config ESP_RMAKER_OTA_AUTOFETCH
        bool "Auto Fetch OTA"
        default y
        help
            Applicable only for OTA using Topics.
            Fetch the OTA (i.e. get the URL and other details) by actively sending an
            OTA fetch request to ESP RainMaker Cloud. If this is disabled, the node
            will stay subscribed to the OTA Topics, but will get the information only
            if someone explicitly triggers it.

    config ESP_RMAKER_OTA_AUTOFETCH_PERIOD
        int "OTA Auto Fetch Period"
        default 0
        range 0 168
        depends on ESP_RMAKER_OTA_AUTOFETCH
        help
            Periodically send an OTA fetch request. If set to 0, the request will be sent only once,
            when the node connects to the ESP RainMaker Cloud first time after a boot.
            Else, this defines the period (in hours) for the periodic fetch request.

    config ESP_RMAKER_SKIP_COMMON_NAME_CHECK
        bool "Skip server certificate CN field check"
        default n
        help
            This allows you to skip the validation of OTA server certificate CN field.

    config ESP_RMAKER_SKIP_VERSION_CHECK
        bool "Skip firmware version check"
        default n
        help
            This allows you to skip the firmware version check. Useful during development,
            but not for production.

    config ESP_RMAKER_SKIP_PROJECT_NAME_CHECK
        bool "Skip project name check"
        default n
        help
            This allows you to skip the project name check.

endmenu
```

## components/esp_schedule/Kconfig
```kconfig
menu "ESP Schedule Configuration"

    config ESP_SCHEDULE_ENABLE_DAYLIGHT
        bool "Enable Daylight (Sunrise/Sunset) Schedules"
        default y
        help
            Enable support for sunrise and sunset based schedules.

            This feature allows scheduling based on astronomical calculations
            for sunrise and sunset times at specific geographical locations.

            Disabling this option will:
            - Remove sunrise/sunset schedule types from the API
            - Save memory by excluding solar calculation code
            - Reduce binary size (by about 11500 bytes)

            If disabled, ESP_SCHEDULE_TYPE_SUNRISE and ESP_SCHEDULE_TYPE_SUNSET
            will not be available.

endmenu
```

## components/rmaker_ota_https/Kconfig.projbuild
```kconfig
menu "ESP RainMaker HTTPS OTA Config"
    config OTA_HTTPS_AUTOFETCH_ENABLED
        bool "Enable Autofetch"
        default y
        help
            Enable periodic checking of OTA.

    config OTA_HTTPS_AUTOFETCH_PERIOD
        int "Autofetch Period"
        depends on OTA_HTTPS_AUTOFETCH_ENABLED
        default 2
        help
            The time period(in hours) for checking OTA.
            If disabled, OTA is only checked once, when HTTPS OTA is enabled.

    config OTA_HTTPS_ROLLBACK_PERIOD
        int "Rollback Period"
        default 90
        help
            The time period for checking if OTA is valid.
            If OTA is not marked valid in this timeframe, firmware is rolled back.

    config OTA_HTTPS_APPLY_STACK_SIZE
        int "Stack size(in bytes) of the task reponsible for calling the OTA callback"
        default 3072
endmenu
```

## components/ws2812_led/Kconfig
```kconfig
menu "WS2812 RGB LED"

    config WS2812_LED_ENABLE
        bool "Enable RGB LED"
        default y if IDF_TARGET_ESP32S2 || IDF_TARGET_ESP32C3
        default n
        help
            Disable the WS2812 RGB LED.

    config WS2812_LED_GPIO
        int "WS2812 LED GPIO"
        default 8 if IDF_TARGET_ESP32C3
        default 18
        depends on WS2812_LED_ENABLE
        help
            Set the WS2812 RGB LED GPIO.

endmenu
```

## examples/camera/split_mode/rmaker_split_camera/sdkconfig.defaults
```kconfig
# signaling_only side of the split (default: ESP32-C6)
CONFIG_IDF_TARGET="esp32c6"
CONFIG_IDF_TARGET_ESP32C6=y

#
# Serial flasher config
#
CONFIG_ESPTOOLPY_FLASHMODE_QIO=y
CONFIG_ESPTOOLPY_FLASHFREQ_80M=y
CONFIG_ESPTOOLPY_FLASHSIZE_4MB=y

#
# Partition Table
#
CONFIG_PARTITION_TABLE_CUSTOM=y
CONFIG_PARTITION_TABLE_CUSTOM_FILENAME="partitions.csv"
CONFIG_PARTITION_TABLE_FILENAME="partitions.csv"
CONFIG_PARTITION_TABLE_OFFSET=0xC000

#
# SPI RAM config
#
CONFIG_SPIRAM=y
CONFIG_SPIRAM_TRY_ALLOCATE_WIFI_LWIP=y

CONFIG_SPIRAM_USE_MALLOC=y
CONFIG_SPIRAM_MALLOC_ALWAYSINTERNAL=0
CONFIG_SPIRAM_MALLOC_RESERVE_INTERNAL=32768
CONFIG_SPIRAM_ALLOW_BSS_SEG_EXTERNAL_MEMORY=y
CONFIG_SPIRAM_ALLOW_STACK_EXTERNAL_MEMORY=y
CONFIG_SPIRAM_SPEED_80M=y

CONFIG_FATFS_LFN_HEAP=y
CONFIG_FATFS_MAX_LFN=255
CONFIG_FATFS_ALLOC_PREFER_EXTRAM=y

#
# SNTP
#
CONFIG_LWIP_SNTP_MAX_SERVERS=3

#CONFIG_LWIP_SO_LINGER=y
#CONFIG_LWIP_SO_RCVBUF=y
#CONFIG_LWIP_NETBUF_RECVINFO=y
#CONFIG_LWIP_IP_FRAG=y
#CONFIG_LWIP_STATS=y

#CONFIG_LWIP_MULTICAST_PING=y
#CONFIG_LWIP_BROADCAST_PING=y

CONFIG_LWIP_DHCP_MAX_NTP_SERVERS=1

CONFIG_MBEDTLS_EXTERNAL_MEM_ALLOC=y

#
# FreeRTOS
#
CONFIG_FREERTOS_PLACE_FUNCTIONS_INTO_FLASH=y
CONFIG_FREERTOS_PLACE_SNAPSHOT_FUNS_INTO_FLASH=y

#
# ESP Ringbuf
#
CONFIG_RINGBUF_PLACE_FUNCTIONS_INTO_FLASH=y
CONFIG_RINGBUF_PLACE_ISR_FUNCTIONS_INTO_FLASH=y

#
# ESP System Settings
#
CONFIG_ESP_SYSTEM_ALLOW_RTC_FAST_MEM_AS_HEAP=y

#
# PThreads
#
CONFIG_PTHREAD_TASK_STACK_SIZE_DEFAULT=8000
CONFIG_PTHREAD_STACK_MIN=4096

CONFIG_IPC_TASK_STACK_SIZE=1024
CONFIG_TIMER_TASK_STACK_SIZE=3584
CONFIG_FREERTOS_SUPPORT_STATIC_ALLOCATION=y

#
# Wi-Fi
#
CONFIG_ESP_WIFI_STATIC_TX_BUFFER=n
CONFIG_ESP_WIFI_DYNAMIC_TX_BUFFER=y

CONFIG_ESP_SYSTEM_EVENT_TASK_STACK_SIZE=4000

# mbedtls dynamic buffer for memory optimization
CONFIG_MBEDTLS_DYNAMIC_BUFFER=y
CONFIG_MBEDTLS_ASYMMETRIC_CONTENT_LEN=y

CONFIG_MBEDTLS_DYNAMIC_FREE_CONFIG_DATA=y
CONFIG_MBEDTLS_DYNAMIC_FREE_CA_CERT=y
CONFIG_MBEDTLS_SSL_VARIABLE_BUFFER_LENGTH=n
CONFIG_MBEDTLS_DYNAMIC_FREE_PEER_CERT=y

CONFIG_FREERTOS_HZ=1000

CONFIG_LWIP_TCP_SND_BUF_DEFAULT=5760
CONFIG_LWIP_TCP_WND_DEFAULT=5760
CONFIG_LWIP_TCP_RECVMBOX_SIZE=6
CONFIG_LWIP_UDP_RECVMBOX_SIZE=6
CONFIG_LWIP_TCPIP_RECVMBOX_SIZE=64

# For BLE Provisioning using NimBLE stack (Not applicable for ESP32-S2)
CONFIG_BT_ENABLED=y
CONFIG_BTDM_CTRL_MODE_BLE_ONLY=y
CONFIG_BT_NIMBLE_ENABLED=y

#
# KVS WebRTC options
#
CONFIG_PREFER_DYNAMIC_ALLOCS=y
CONFIG_USE_ESP_WEBSOCKET_CLIENT=y
CONFIG_ENABLE_DATA_CHANNEL=n

#
# Websockets
#
CONFIG_WS_BUFFER_SIZE=2048
CONFIG_WS_DYNAMIC_BUFFER=y

#
# MDNS Memory Configuration
#
CONFIG_MDNS_TASK_CREATE_FROM_SPIRAM=y
CONFIG_MDNS_MEMORY_ALLOC_SPIRAM=y

#
# ESP RainMaker Configuration
#
ESP_RMAKER_USER_ID_CHECK=y
CONFIG_ESP_RMAKER_CLAIM_VIDEOSTREAM_SUPPORT=y
CONFIG_ESP_RMAKER_CONSOLE_ENABLED=n
CONFIG_ESP_RMAKER_ENABLE_CHALLENGE_RESPONSE=y
CONFIG_ESP_RMAKER_ASSISTED_CLAIM=y

#
# RainMaker Camera Mode Configuration
#
CONFIG_ENABLE_SIGNALLING_ONLY=y
```

## examples/camera/split_mode/rmaker_split_camera/sdkconfig.defaults.esp32c6
```kconfig
# perform the size optimized builds for C6 to avoid app size overflow
CONFIG_COMPILER_OPTIMIZATION_SIZE=y

# SPI Configuration
CONFIG_SPI_MASTER_ISR_IN_IRAM=n
CONFIG_SPI_SLAVE_ISR_IN_IRAM=n

# SPI Flash driver
CONFIG_SPI_FLASH_ROM_DRIVER_PATCH=n
CONFIG_SPI_FLASH_ROM_IMPL=y

# Peripheral Control
CONFIG_PERIPH_CTRL_FUNC_IN_IRAM=n

#
# ESP System Settings
#
CONFIG_ESP_SYSTEM_ALLOW_RTC_FAST_MEM_AS_HEAP=y

# Event Loop Library
CONFIG_ESP_EVENT_POST_FROM_ISR=n

#
# PThreads
#
CONFIG_PTHREAD_TASK_STACK_SIZE_DEFAULT=8000
CONFIG_PTHREAD_STACK_MIN=4096

CONFIG_MAIN_TASK_STACK_SIZE=6000
CONFIG_IPC_TASK_STACK_SIZE=1024
CONFIG_TIMER_TASK_STACK_SIZE=3584
CONFIG_FREERTOS_SUPPORT_STATIC_ALLOCATION=y

#
# Wi-Fi
#
CONFIG_ESP_WIFI_IRAM_OPT=n
CONFIG_ESP_WIFI_RX_IRAM_OPT=n
CONFIG_ESP_WIFI_EXTRA_IRAM_OPT=n
CONFIG_ESP_WIFI_SLP_IRAM_OPT=n

CONFIG_FREERTOS_HZ=1000

CONFIG_LWIP_TCP_SND_BUF_DEFAULT=5760
CONFIG_LWIP_TCP_WND_DEFAULT=5760
CONFIG_LWIP_TCP_RECVMBOX_SIZE=6
CONFIG_LWIP_UDP_RECVMBOX_SIZE=6
CONFIG_LWIP_TCPIP_RECVMBOX_SIZE=64

#
# ESP-Hosted - Network coprocessor
#
CONFIG_SLAVE_LWIP_ENABLED=y
CONFIG_ESP_SDIO_RX_Q_SIZE=10
```

## examples/camera/standalone/sdkconfig.defaults.esp32
```kconfig
#
# ESP32-Specific
#
CONFIG_ESP32_DEFAULT_CPU_FREQ_240=y
CONFIG_ESP32_DEFAULT_CPU_FREQ_MHZ=240

#
# Wi-Fi
#
CONFIG_ESP32_WIFI_STATIC_TX_BUFFER=y
CONFIG_ESP32_WIFI_TX_BUFFER_TYPE=0
CONFIG_ESP32_WIFI_STATIC_TX_BUFFER_NUM=16
CONFIG_ESP32_WIFI_IRAM_OPT=n
CONFIG_ESP32_WIFI_RX_IRAM_OPT=n

#
# SPI RAM config
#
CONFIG_SPIRAM_BANKSWITCH_ENABLE=y
CONFIG_SPIRAM_BANKSWITCH_RESERVE=8
```

## examples/common/app_insights/Kconfig
```kconfig
menu "App Insights"
visible if ESP_INSIGHTS_ENABLED

    config APP_INSIGHTS_ENABLE_LOG_TYPE_ALL
        bool "Enable all diagnostics log type"
        default y
        help
            By default this enables error and event diagnostics log types.
            This config option quickly disables the capture of all these log types.

endmenu
```

## examples/common/app_wifi/Kconfig
```kconfig
menu "App Wi-Fi Provisioning"

    config APP_WIFI_PROV_SHOW_QR
        bool "Show provisioning QR code"
        default y
        help
            Show the QR code for provisioning.

endmenu
```

## examples/common/app_wifi/Kconfig.projbuild
```kconfig
menu "ESP RainMaker App Wi-Fi Provisioning"

    config APP_WIFI_PROV_SHOW_QR
        bool "Show provisioning QR code"
        default y
        help
            Show the QR code for provisioning.

    choice APP_WIFI_PROV_TRANSPORT
        bool "Provisioning Transport method"
        default APP_WIFI_PROV_TRANSPORT_BLE
        help
            Wi-Fi provisioning component offers both, SoftAP and BLE transports. Choose any one.

        config APP_WIFI_PROV_TRANSPORT_SOFTAP
            bool "Soft AP"
        config APP_WIFI_PROV_TRANSPORT_BLE
            bool "BLE"
            select BT_ENABLED
            depends on IDF_TARGET_ESP32 || IDF_TARGET_ESP32C3
    endchoice

    config APP_WIFI_PROV_TRANSPORT
        int
        default 1 if APP_WIFI_PROV_TRANSPORT_SOFTAP
        default 2 if APP_WIFI_PROV_TRANSPORT_BLE

    config APP_WIFI_SHOW_DEMO_INTRO_TEXT
        bool "Show intro text for demos"
        default n
        help
            Show some intro text for demos in order to help users understand more about ESP RainMaker.

endmenu
```

## examples/common/rmaker_user_api/Kconfig
```kconfig
menu "RainMaker User API Configuration"

    config RM_USER_SUPPORT_REUSE_HTTP_SESSION
        bool "Support User HTTP Session Reuse"
        default y
        help
            Option to make User API reuse previous HTTP connection.
            This retains the User HTTP session with backend so that TLS handshake is not repeated.
            This speeds up operations, but has an impact on heap memory as the session will stay allocated.
            It need ESP-IDF version >= 5.4.

    config ENABLE_RM_USER_HELPER_API
        bool "Enable helper RainMaker User API"
        default n
        help
            Enable helper C APIs for common User API handling so that creating the HTTP requests and parsing the responses can be avoided.
            Refer the header file for more info.

endmenu
```
