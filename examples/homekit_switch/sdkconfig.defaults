## examples/homekit_switch/sdkconfig.defaults
```kconfig
CONFIG_ESPTOOLPY_FLASHSIZE_4MB=y

#
# Use partition table which makes use of flash to the fullest
# Can be used for other platforms as well. But please keep in mind that fctry partition address is
# different than default, and the new address needs to be specified to `rainmaker.py claim`
#
CONFIG_PARTITION_TABLE_CUSTOM=y
CONFIG_PARTITION_TABLE_CUSTOM_FILENAME="partitions_4mb_optimised.csv"

# To accomodate security features
CONFIG_PARTITION_TABLE_OFFSET=0xc000

# mbedtls
CONFIG_MBEDTLS_DYNAMIC_BUFFER=y
CONFIG_MBEDTLS_DYNAMIC_FREE_PEER_CERT=y
CONFIG_MBEDTLS_DYNAMIC_FREE_CONFIG_DATA=y
CONFIG_MBEDTLS_HARDWARE_MPI=y
CONFIG_MBEDTLS_CERTIFICATE_BUNDLE_DEFAULT_CMN=y

#LWIP
CONFIG_LWIP_MAX_SOCKETS=16
CONFIG_LWIP_SO_REUSE=y
CONFIG_LWIP_MAX_ACTIVE_TCP=12
CONFIG_LWIP_MAX_LISTENING_TCP=12
CONFIG_LWIP_UDP_RECVMBOX_SIZE=10
CONFIG_LWIP_AUTOIP=y
CONFIG_LWIP_AUTOIP_RATE_LIMIT_INTERVAL=60

# For BLE Provisioning using NimBLE stack (Not applicable for ESP32-S2)
CONFIG_BT_ENABLED=y
CONFIG_BTDM_CTRL_MODE_BLE_ONLY=y
CONFIG_BT_NIMBLE_ENABLED=y

# Temporary Fix for Timer Overflows
CONFIG_FREERTOS_TIMER_TASK_STACK_DEPTH=3120

# For additional security on reset to factory
CONFIG_ESP_RMAKER_USER_ID_CHECK=y

# Application Rollback
CONFIG_BOOTLOADER_APP_ROLLBACK_ENABLE=y

# Change default log level to reduce binary size
CONFIG_LOG_DEFAULT_LEVEL_WARN=y

# If ESP-Insights is enabled, we need MQTT transport selected
# Takes out manual efforts to enable this option
CONFIG_ESP_INSIGHTS_TRANSPORT_MQTT=y

# Disable network provisioning component as it conflicts with the wifi provisioning component used here
CONFIG_ESP_RMAKER_USING_NETWORK_PROV=n
```

## examples/homekit_switch/sdkconfig.defaults.esp32
```kconfig
# To prevent IRAM overflow errors
CONFIG_FREERTOS_PLACE_FUNCTIONS_INTO_FLASH=y
CONFIG_FREERTOS_PLACE_SNAPSHOT_FUNS_INTO_FLASH=y
```

## examples/led_light/main/Kconfig.projbuild
```kconfig
menu "Example Configuration"

    config EXAMPLE_BOARD_BUTTON_GPIO
        int "Boot Button GPIO"
        default 28 if IDF_TARGET_ESP32C5
        default 9 if IDF_TARGET_ESP32C3 || IDF_TARGET_ESP32C6 || IDF_TARGET_ESP32C2 || IDF_TARGET_ESP32H2
        default 0
        help
            GPIO number on which the "Boot" button is connected. This is generally used
            by the application for custom operations like toggling states, resetting to defaults, etc.

    config APP_POP_TYPE
        int "Proof of Posession Type"
        default 1
        range 0 2
        help
            0: POP_TYPE_MAC
            1: POP_TYPE_RANDOM
            2: POP_TYPE_NONE
endmenu
```

## examples/led_light/sdkconfig.defaults
```kconfig
CONFIG_ESPTOOLPY_FLASHSIZE_4MB=y

#
# Use partition table which makes use of flash to the fullest
# Can be used for other platforms as well. But please keep in mind that fctry partition address is
# different than default, and the new address needs to be specified to `rainmaker.py claim`
#
CONFIG_PARTITION_TABLE_CUSTOM=y
CONFIG_PARTITION_TABLE_CUSTOM_FILENAME="partitions_4mb_optimised.csv"

# To accomodate security features
CONFIG_PARTITION_TABLE_OFFSET=0xc000

# mbedtls
CONFIG_MBEDTLS_DYNAMIC_BUFFER=y
CONFIG_MBEDTLS_DYNAMIC_FREE_PEER_CERT=y
CONFIG_MBEDTLS_DYNAMIC_FREE_CONFIG_DATA=y
CONFIG_MBEDTLS_CERTIFICATE_BUNDLE_DEFAULT_CMN=y

# For BLE Provisioning using NimBLE stack (Not applicable for ESP32-S2)
CONFIG_BT_ENABLED=y
CONFIG_BTDM_CTRL_MODE_BLE_ONLY=y
CONFIG_BT_NIMBLE_ENABLED=y

# Temporary Fix for Timer Overflows
CONFIG_FREERTOS_TIMER_TASK_STACK_DEPTH=3120

# For additional security on reset to factory
CONFIG_ESP_RMAKER_USER_ID_CHECK=y

# Secure Local Control
CONFIG_ESP_RMAKER_LOCAL_CTRL_AUTO_ENABLE=y
#CONFIG_ESP_RMAKER_LOCAL_CTRL_ENABLE is deprecated but will continue to work
CONFIG_ESP_RMAKER_LOCAL_CTRL_SECURITY_1=y

# Application Rollback
CONFIG_BOOTLOADER_APP_ROLLBACK_ENABLE=y

# If ESP-Insights is enabled, we need MQTT transport selected
# Takes out manual efforts to enable this option
CONFIG_ESP_INSIGHTS_TRANSPORT_MQTT=y
```

## examples/led_light_Core2ForAWS/sdkconfig.defaults
```kconfig
CONFIG_ESPTOOLPY_FLASHMODE_QIO=y
CONFIG_ESPTOOLPY_FLASHFREQ_80M=y
CONFIG_ESPTOOLPY_FLASHFREQ="80m"
CONFIG_ESPTOOLPY_FLASHSIZE_16MB=y
CONFIG_ESPTOOLPY_FLASHSIZE="16MB"
CONFIG_PARTITION_TABLE_SINGLE_APP=
CONFIG_PARTITION_TABLE_TWO_OTA=
CONFIG_PARTITION_TABLE_CUSTOM=y
CONFIG_PARTITION_TABLE_CUSTOM_FILENAME="partitions.csv"
CONFIG_PARTITION_TABLE_FILENAME="partitions.csv"
CONFIG_PARTITION_TABLE_OFFSET=0x8000
CONFIG_PARTITION_TABLE_MD5=y

# CONFIG_ESP_TASK_WDT is not set

# mbedtls
# CONFIG_MBEDTLS_INTERNAL_MEM_ALLOC is not set
CONFIG_MBEDTLS_EXTERNAL_MEM_ALLOC=y
CONFIG_MBEDTLS_DYNAMIC_BUFFER=y
CONFIG_MBEDTLS_DYNAMIC_FREE_PEER_CERT=y
CONFIG_MBEDTLS_DYNAMIC_FREE_CONFIG_DATA=y

# For BLE Provisioning using NimBLE stack (ESP32 only)
CONFIG_BT_ENABLED=y
CONFIG_BTDM_CTRL_MODE_BLE_ONLY=y
CONFIG_BT_NIMBLE_ENABLED=y
CONFIG_NIMBLE_ENABLED=y
CONFIG_NIMBLE_MEM_ALLOC_MODE_EXTERNAL=y

CONFIG_ESP32_DEFAULT_CPU_FREQ_240=y
CONFIG_ESP32_DEFAULT_CPU_FREQ_MHZ=240
CONFIG_ESP32_SPIRAM_SUPPORT=y
CONFIG_SPIRAM_SPEED_80M=y
CONFIG_SPIRAM=y
CONFIG_SPIRAM_BOOT_INIT=y

# CONFIG_SPI_MASTER_IN_IRAM is not set
# CONFIG_SPI_MASTER_ISR_IN_IRAM is not set
# CONFIG_SPI_SLAVE_IN_IRAM is not set
# CONFIG_SPI_SLAVE_ISR_IN_IRAM is not set

CONFIG_ESP32_WIFI_STATIC_RX_BUFFER_NUM=4
CONFIG_ESP32_WIFI_DYNAMIC_RX_BUFFER_NUM=16
CONFIG_ESP32_WIFI_STATIC_TX_BUFFER=y
CONFIG_ESP32_WIFI_TX_BUFFER_TYPE=0
CONFIG_ESP32_WIFI_STATIC_TX_BUFFER_NUM=8
CONFIG_ESP32_WIFI_CACHE_TX_BUFFER_NUM=16
# CONFIG_ESP32_WIFI_CSI_ENABLED is not set
# CONFIG_ESP32_WIFI_AMPDU_TX_ENABLED is not set
# CONFIG_ESP32_WIFI_AMPDU_RX_ENABLED is not set
CONFIG_ESP32_WIFI_NVS_ENABLED=y
CONFIG_ESP32_WIFI_TASK_PINNED_TO_CORE_0=y
# CONFIG_ESP32_WIFI_TASK_PINNED_TO_CORE_1 is not set
CONFIG_ESP32_WIFI_SOFTAP_BEACON_MAX_LEN=752
CONFIG_ESP32_WIFI_MGMT_SBUF_NUM=32
# CONFIG_ESP32_WIFI_DEBUG_LOG_ENABLE is not set
# CONFIG_ESP32_WIFI_IRAM_OPT is not set
# CONFIG_ESP32_WIFI_RX_IRAM_OPT is not set

CONFIG_LV_HOR_RES_MAX=320
CONFIG_LV_VER_RES_MAX=240
CONFIG_LV_COLOR_DEPTH_16=y
CONFIG_LV_COLOR_DEPTH=16
CONFIG_LV_COLOR_16_SWAP=y
CONFIG_LV_MEM_SIZE_BYTES=16
```

## examples/matter/client_only_matter_controller/sdkconfig.defaults
```kconfig
CONFIG_ESPTOOLPY_FLASHSIZE_8MB=y
CONFIG_PARTITION_TABLE_CUSTOM=y
CONFIG_PARTITION_TABLE_CUSTOM_FILENAME="partitions.csv"
CONFIG_PARTITION_TABLE_FILENAME="partitions.csv"

# mbedtls
CONFIG_MBEDTLS_DYNAMIC_BUFFER=y
CONFIG_MBEDTLS_DYNAMIC_FREE_CONFIG_DATA=y
CONFIG_MBEDTLS_CERTIFICATE_BUNDLE_DEFAULT_CMN=y
CONFIG_MBEDTLS_HKDF_C=y

# For BLE Provisioning using NimBLE stack
CONFIG_BT_ENABLED=y
CONFIG_BT_NIMBLE_ENABLED=y

# Temporary Fix for Timer Overflows
CONFIG_FREERTOS_TIMER_TASK_STACK_DEPTH=3120

# For additional security on reset to factory
CONFIG_ESP_RMAKER_USER_ID_CHECK=y

# Application Rollback
CONFIG_BOOTLOADER_APP_ROLLBACK_ENABLE=y

# Use platform mdns
CONFIG_USE_MINIMAL_MDNS=n

# Enable Matter shell
CONFIG_ENABLE_CHIP_SHELL=y
CONFIG_ESP_MATTER_CONSOLE_TASK_STACK=4096

# Disable Matter server and enable Controller
CONFIG_ESP_MATTER_ENABLE_MATTER_SERVER=n
CONFIG_ENABLE_CHIP_CONTROLLER_BUILD=y
CONFIG_ESP_MATTER_CONTROLLER_ENABLE=y
CONFIG_ESP_MATTER_COMMISSIONER_ENABLE=n
CONFIG_ESP_MATTER_CONTROLLER_CUSTOM_CLUSTER_ENABLE=n

# Disable network commissioning driver
CONFIG_WIFI_NETWORK_COMMISSIONING_DRIVER=n
CONFIG_THREAD_NETWORK_COMMISSIONING_DRIVER=n

# Use custom credentials issuer
CONFIG_CUSTOM_OPERATIONAL_CREDS_ISSUER=y

# Disable Matter over SoftAP and BLE
CONFIG_ENABLE_WIFI_AP=n
CONFIG_ENABLE_CHIPOBLE=n
CONFIG_USE_BLE_ONLY_FOR_COMMISSIONING=n

# Matter Commissioning Window should be closed on starting
CONFIG_CHIP_ENABLE_PAIRING_AUTOSTART=n

# Increase IPv6 address Number
CONFIG_LWIP_IPV6_NUM_ADDRESSES=6

# Increase udp endpoints number
CONFIG_NUM_UDP_ENDPOINTS=16

# Enable lwIP route hooks
CONFIG_LWIP_HOOK_IP6_ROUTE_DEFAULT=y
CONFIG_LWIP_HOOK_ND6_GET_GW_DEFAULT=y
CONFIG_LWIP_IPV6_AUTOCONFIG=y

# Increase Main Task stack
CONFIG_ESP_MAIN_TASK_STACK_SIZE=8192

# Enable Controller REST APIs
CONFIG_RMAKER_REST_API_ENABLED=y

# Increase MQTT task stack size
CONFIG_MQTT_USE_CUSTOM_CONFIG=y
CONFIG_MQTT_TASK_STACK_SIZE=8192
```

## examples/matter/common/controller_custom_cluster/Kconfig
```kconfig
menu "Custom Controller Cluster"
    config CONTROLLER_CUSTOM_CLUSTER_ENABLE
        bool "Enable controller custom cluster"
        depends on ESP_MATTER_CONTROLLER_ENABLE && ESP_MATTER_ENABLE_MATTER_SERVER && RMAKER_REST_API_ENABLED
        default n
        help
            Enable the custom cluster of matter controller for Rainmaker Fabric suppport.

endmenu
```

## examples/matter/common/controller_rest_apis/Kconfig
```kconfig
menu "RMaker REST API"
    config RMAKER_REST_API_ENABLED
        bool "Enable RMaker REST API"
        default y
        help
            Enable RainMaker REST API

endmenu
```

## examples/matter/matter_controller_on_esp32_s3_box/sdkconfig.defaults
```kconfig
# Default to 921600 baud when flashing and monitoring device
CONFIG_ESPTOOLPY_BAUD_921600B=y
CONFIG_ESPTOOLPY_BAUD=921600
CONFIG_ESPTOOLPY_COMPRESSED=y
CONFIG_ESPTOOLPY_MONITOR_BAUD_115200B=y
CONFIG_ESPTOOLPY_MONITOR_BAUD=115200
# CONFIG_ESPTOOLPY_FLASHSIZE_4MB=y
CONFIG_ESPTOOLPY_FLASHSIZE_16MB=y
CONFIG_ESPTOOLPY_FLASHMODE_QIO=y
# CONFIG_ESPTOOLPY_FLASHSIZE_DETECT is not set

# cpu 
CONFIG_ESP_DEFAULT_CPU_FREQ_MHZ_240=y
CONFIG_ESP32S3_DEFAULT_CPU_FREQ_240=y
CONFIG_ESP32S3_INSTRUCTION_CACHE_32KB=y
CONFIG_ESP32S3_DATA_CACHE_64KB=y
CONFIG_ESP32S3_DATA_CACHE_LINE_64B=y


#enable BT
CONFIG_BT_ENABLED=y
CONFIG_BT_NIMBLE_ENABLED=y
CONFIG_NIMBLE_MEM_ALLOC_MODE_EXTERNAL=y

# enable lwip ipv6 autoconfig
CONFIG_LWIP_IPV6_AUTOCONFIG=y

# Use a custom partition table
CONFIG_PARTITION_TABLE_CUSTOM=y
CONFIG_PARTITION_TABLE_FILENAME="partitions.csv"
CONFIG_PARTITION_TABLE_OFFSET=0x8000
CONFIG_PARTITION_TABLE_MD5=y

# Enable chip shell
CONFIG_ENABLE_CHIP_SHELL=y

# Temporary Fix for Timer Overflows
CONFIG_FREERTOS_TIMER_TASK_STACK_DEPTH=4096

#enable lwIP route hooks
CONFIG_LWIP_HOOK_IP6_ROUTE_DEFAULT=y
CONFIG_LWIP_HOOK_ND6_GET_GW_DEFAULT=y

# Button
CONFIG_BUTTON_PERIOD_TIME_MS=20
CONFIG_BUTTON_LONG_PRESS_TIME_MS=5000
CONFIG_ADC_BUTTON_MAX_BUTTON_PER_CHANNEL=4

# ESP RainMaker
CONFIG_ESP_RMAKER_USER_ID_CHECK=y
CONFIG_ESP_RMAKER_NO_CLAIM=y
CONFIG_ESP_RMAKER_USE_ESP_SECURE_CERT_MGR=y
CONFIG_ESP_RMAKER_READ_NODE_ID_FROM_CERT_CN=y

# ESP Matter
CONFIG_CHIP_FACTORY_NAMESPACE_PARTITION_LABEL="fctry"
CONFIG_ENABLE_ESP32_FACTORY_DATA_PROVIDER=y
CONFIG_ENABLE_ESP32_DEVICE_INSTANCE_INFO_PROVIDER=y
CONFIG_ENABLE_ESP32_DEVICE_INFO_PROVIDER=y
CONFIG_SEC_CERT_DAC_PROVIDER=y
CONFIG_DEVICE_VENDOR_ID=0x131B
CONFIG_DEVICE_PRODUCT_ID=0x2
CONFIG_ESP_MATTER_MEM_ALLOC_MODE_EXTERNAL=y

CONFIG_ESP_SECURE_CERT_DS_PERIPHERAL=n

# Enable controller
CONFIG_ENABLE_CHIP_CONTROLLER_BUILD=y
CONFIG_ESP_MATTER_CONTROLLER_ENABLE=y
CONFIG_ESP_MATTER_COMMISSIONER_ENABLE=n

# Increase stack size
CONFIG_ESP_SYSTEM_EVENT_TASK_STACK_SIZE=4096
CONFIG_ESP_MATTER_CONSOLE_TASK_STACK=5120
CONFIG_CHIP_TASK_STACK_SIZE=15360
CONFIG_ESP_MAIN_TASK_STACK_SIZE=10240

# Increase udp endpoints number
CONFIG_NUM_UDP_ENDPOINTS=16

# Increase LwIP IPv6 address number to 6 (MAX_FABRIC + 1)
CONFIG_LWIP_IPV6_NUM_ADDRESSES=6

# lv config
CONFIG_LV_COLOR_16_SWAP=y
CONFIG_LV_MEM_CUSTOM=y
CONFIG_LV_FONT_FMT_TXT_LARGE=y
CONFIG_LV_FONT_MONTSERRAT_24=y
CONFIG_LV_FONT_MONTSERRAT_32=y
CONFIG_LV_USE_QRCODE=y
CONFIG_LV_USE_FONT_PLACEHOLDER=n

# Disable ble only for commission
CONFIG_USE_BLE_ONLY_FOR_COMMISSIONING=n

# BSP
CONFIG_BSP_LCD_DRAW_BUF_HEIGHT=10

CONFIG_ESP_ALLOW_BSS_SEG_EXTERNAL_MEMORY=y

# SPIRAM
CONFIG_ESP32S3_SPIRAM_SUPPORT=y
CONFIG_SPIRAM_MODE_OCT=y
CONFIG_SPIRAM_SPEED_80M=y
CONFIG_SPIRAM_MALLOC_ALWAYSINTERNAL=512
CONFIG_SPIRAM_MALLOC_RESERVE_INTERNAL=8192
CONFIG_SPIRAM_ALLOW_BSS_SEG_EXTERNAL_MEMORY=y
CONFIG_SPIRAM_TRY_ALLOCATE_WIFI_LWIP=y

CONFIG_ESP_CONSOLE_USB_SERIAL_JTAG=y

# freertos
CONFIG_FREERTOS_VTASKLIST_INCLUDE_COREID=y
CONFIG_FREERTOS_GENERATE_RUN_TIME_STATS=y
CONFIG_FREERTOS_PLACE_FUNCTIONS_INTO_FLASH=y
CONFIG_FREERTOS_HZ=1000
CONFIG_FREERTOS_ENABLE_TASK_SNAPSHOT=n

CONFIG_LWIP_TCPIP_RECVMBOX_SIZE=16

# mbedTLS
CONFIG_MBEDTLS_EXTERNAL_MEM_ALLOC=y
CONFIG_MBEDTLS_DYNAMIC_BUFFER=y
CONFIG_MBEDTLS_DYNAMIC_FREE_PEER_CERT=y
CONFIG_MBEDTLS_DYNAMIC_FREE_CONFIG_DATA=y
CONFIG_MBEDTLS_SSL_PROTO_TLS1=n
CONFIG_MBEDTLS_SSL_PROTO_TLS1_1=n
CONFIG_MBEDTLS_TLS_CLIENT_ONLY=y
CONFIG_MBEDTLS_HKDF_C=y

# Temporary fix for allocating RSA interrupt failed
CONFIG_MBEDTLS_AES_USE_INTERRUPT=n

# IPC (Inter-Processor Call)
CONFIG_ESP_IPC_TASK_STACK_SIZE=2048

# Wi-Fi
# CONFIG_ESP32_WIFI_STATIC_RX_BUFFER_NUM=3
# CONFIG_ESP32_WIFI_DYNAMIC_RX_BUFFER_NUM=4
# CONFIG_ESP32_WIFI_STATIC_TX_BUFFER_NUM=4
# CONFIG_ESP32_WIFI_CACHE_TX_BUFFER_NUM=16
# CONFIG_ESP32_WIFI_TX_BA_WIN=4
# CONFIG_ESP32_WIFI_RX_BA_WIN=4
# CONFIG_ESP32_WIFI_AMSDU_TX_ENABLED=y

# Increase attribute buffer largest
CONFIG_ESP_MATTER_ATTRIBUTE_BUFFER_LARGEST=2050

CONFIG_IDF_TARGET="esp32s3"
```

## examples/matter/matter_controller_with_touchscreen/components/choose_bsp/Kconfig.projbuild
```kconfig
menu "HMI Board Config"
    choice BSP_LCD_BOARD
        prompt "Select BSP board"
        default BSP_BOARD_ESP32_S3_BOX_3

        config BSP_BOARD_ESP32_S3_BOX
            bool "BSP board ESP32-S3-BOX"

        config BSP_BOARD_ESP32_S3_BOX_Lite
            bool "BSP board ESP32-S3-BOX-Lite"

        config BSP_BOARD_ESP32_S3_BOX_3
            bool "BSP board ESP32-S3-BOX-3"

        config BSP_BOARD_ESP32_S3_LCD_EV_BOARD
            bool "BSP board ESP32-S3-LCD-EV-Board"

        config BSP_BOARD_M5STACK_CORES3
            bool "BSP board M5Stack CoreS3"
    endchoice

    menu "Board Configuration"
        depends on OPENTHREAD_BORDER_ROUTER
        config PIN_TO_RCP_RESET
            int
            default "7" if BSP_BOARD_M5STACK_CORES3
            default "42"

        config PIN_TO_RCP_BOOT
            int
            default "18" if BSP_BOARD_M5STACK_CORES3
            default "40"

        config PIN_TO_RCP_TX
            int
            default "4" if BSP_BOARD_ESP32_S3_LCD_EV_BOARD
            default "10" if BSP_BOARD_M5STACK_CORES3
            default "38"

        config PIN_TO_RCP_RX
            int
            default "0" if BSP_BOARD_ESP32_S3_LCD_EV_BOARD
            default "17" if BSP_BOARD_M5STACK_CORES3
            default "41"
    endmenu
endmenu
```

## examples/matter/matter_controller_with_touchscreen/main/Kconfig.projbuild
```kconfig
menu "Controller with Thread BR Example"
    depends on OPENTHREAD_BORDER_ROUTER

    menu "Board Configuration"
        config PIN_TO_RCP_RESET
            depends on OPENTHREAD_BR_AUTO_UPDATE_RCP
            int "Pin to RCP reset"
            default "42"

        config PIN_TO_RCP_BOOT
            depends on OPENTHREAD_BR_AUTO_UPDATE_RCP
            int "Pin to RCP boot"
            default "40"

        config PIN_TO_RCP_TX
            int "Pin to RCP TX"
            default "38"

        config PIN_TO_RCP_RX
            int "Pin to RCP RX"
            default "41"
    endmenu

endmenu
```
