## examples/camera/standalone/sdkconfig.defaults.p4_function_ev_board_v12.esp32p4
```kconfig
CONFIG_PARTITION_TABLE_CUSTOM=y

#
# Chip revision
#
CONFIG_ESP32P4_SELECTS_REV_LESS_V3=y

CONFIG_ESP_SDIO_PIN_D0=14
CONFIG_ESP_SDIO_PIN_D1=15
CONFIG_ESP_CONSOLE_USB_SERIAL_JTAG=y
CONFIG_ESP_CONSOLE_SECONDARY_NONE=y
CONFIG_ESP_CONSOLE_USB_SERIAL_JTAG_ENABLED=y
```

## examples/camera/standalone/sdkconfig.defaults.p4_function_ev_board_v16.esp32p4
```kconfig
CONFIG_PARTITION_TABLE_CUSTOM=y

#
# Chip revision
#
CONFIG_ESP32P4_SELECTS_REV_LESS_V3=n
```

## examples/common/rmaker_matter_controller/Kconfig
```kconfig
menu "ESP RainMaker Matter Controller"

    config RMAKER_MTCTL_TASK_STACK_SIZE
        int "ESP Rainmaker Matter Controller Task Stack Size"
        default 7168
        help
            Set the stack size of ESP Rainmaker Matter Controller task.

    config RMAKER_MTCTL_API_URL_LEN
        int "ESP Rainmaker Matter Controller API URL Buffer Length"
        default 256
        help
            Set the local buffer length used to build RainMaker Matter Controller API query strings.

    menu "Memory"

        config RMAKER_MTCTL_MEMORY_ALLOCATION_PREFER_SPIRAM
            bool "Prefer PSRAM for Matter controller allocations"
            depends on SPIRAM && (SPIRAM_USE_CAPS_ALLOC || SPIRAM_USE_MALLOC)
            default y
            help
                Prefer PSRAM for Matter controller buffers when possible. This saves internal heap.

        config RMAKER_MTCTL_MEMORY_REPORT_TASK_CREATE_FROM_SPIRAM
            bool "Create Matter controller report task stack from PSRAM"
            depends on SPIRAM && (SPIRAM_USE_CAPS_ALLOC || SPIRAM_USE_MALLOC) && FREERTOS_TASK_CREATE_ALLOW_EXT_MEM
            default y
            help
                Allocate the Matter controller report task stack from PSRAM.

    endmenu

    config RMAKER_MTCTL_MAX_DEVICE_COUNT
        int "ESP Rainmaker Matter Controller Max Device Count"
        default 32
        help
            Set the maximum number of Matter devices fetched from RainMaker cloud per device-list update.

    config RMAKER_MTCTL_FETCH_RETRY_COUNT
        int "ESP Rainmaker Matter Controller Fetch Retry Count"
        default 3
        help
            Set the number of retries after a Matter controller cloud API fetch failure. Set to 0 to disable retries.

    config RMAKER_MTCTL_FETCH_RETRY_BACKOFF_SEC
        int "ESP Rainmaker Matter Controller Fetch Retry Backoff (seconds)"
        default 5
        help
            Set the backoff between Matter controller cloud API fetch retries. Set to 0 to retry immediately.

    config RMAKER_MTCTL_MAX_ENDPOINT_COUNT_PER_DEVICE
        int "ESP Rainmaker Matter Controller Max Endpoint Count Per Device"
        range 1 16
        default 4
        help
            Set the maximum endpoint count per device for ESP Rainmaker Matter Controller.

    config RMAKER_MTCTL_MAX_DEVICE_TYPE_COUNT_PER_ENDPOINT
        int "ESP Rainmaker Matter Controller Max Device Type Count Per Endpoint"
        range 1 16
        default 4
        help
            Set the maximum device type count per endpoint for ESP Rainmaker Matter Controller.

    config RMAKER_MTCTL_DEVICE_NAME_MAX_LEN
        int "ESP Rainmaker Matter Controller Device Name Max Length"
        default 32
        help
            Set the maximum stored Matter device name length, including the terminating null byte.

    config RMAKER_MTCTL_RMAKER_NODE_ID_MAX_LEN
        int "ESP Rainmaker Matter Controller RainMaker Node ID Max Length"
        default 40
        help
            Set the maximum stored RainMaker node ID length, including the terminating null byte.

    menu "Report"

        config RMAKER_MTCTL_REPORT_TASK_STACK_SIZE
            int "ESP Rainmaker Matter Controller Report Task Stack Size"
            default 8192
            help
                Set the stack size of ESP Rainmaker Matter Controller report task.

        config RMAKER_MTCTL_REPORT_QUEUE_SIZE
            int "ESP Rainmaker Matter Controller Report Queue Size"
            default 32
            help
                Set the report task queue size for Matter attribute and event reports.

        config RMAKER_MTCTL_REPORT_ATTR_BUCKET_CAPACITY
            int "ESP Rainmaker Matter Controller Attribute Report Bucket Capacity"
            default 3
            help
                Set the number of attribute report batches that may be published quickly after an idle period.

        config RMAKER_MTCTL_REPORT_ATTR_BUCKET_REFILL_MS
            int "ESP Rainmaker Matter Controller Attribute Report Bucket Token Refill (ms)"
            default 10000
            help
                Set the token refill interval used to bound sustained RainMaker attribute report publish rate.

        config RMAKER_MTCTL_REPORT_SUBSCRIBE_TIMEOUT_MS
            int "ESP Rainmaker Matter Controller Report Subscribe Timeout (ms)"
            default 30000
            help
                Set the timeout for Matter report subscription setup.

    endmenu

    menu "Command Response"

        config RMAKER_MTCTL_CMDRESP_MTCMD_TIMEOUT_MS
            int "ESP Rainmaker Matter Controller Matter Command Timeout (ms)"
            default 20000
            help
                Set the timeout for Matter command-response operations.

        config RMAKER_MTCTL_CMDRESP_CMDFIELD_BUFFER_SIZE
            int "ESP Rainmaker Matter Controller Command Field Buffer Size"
            default 120
            help
                Set the buffer size used for command field JSON fragments.

        config RMAKER_MTCTL_CMDRESP_ATTRVAL_BUFFER_SIZE
            int "ESP Rainmaker Matter Controller Attribute Value Buffer Size"
            default 120
            help
                Set the buffer size used for attribute value JSON fragments.

        config RMAKER_MTCTL_CMDRESP_RESPONSE_BUFFER_SIZE
            int "ESP Rainmaker Matter Controller Command Response Buffer Size"
            default 5000
            help
                Set the command-response JSON output buffer size.

    endmenu

endmenu
```

## examples/matter/common/app_end_device/Kconfig.projbuild
```kconfig
menu "RainMaker Matter End Device"

config APP_END_DEVICE_BOARD_BUTTON_GPIO
    int "Boot Button GPIO"
    default 28 if IDF_TARGET_ESP32C5
    default 9 if IDF_TARGET_ESP32C3 || IDF_TARGET_ESP32C6 || IDF_TARGET_ESP32C2 || IDF_TARGET_ESP32H2
    default 0
    help
        GPIO number on which the "Boot" button is connected.

choice APP_END_DEVICE_LED_TYPE
    prompt "LED Type"
    default APP_END_DEVICE_LED_TYPE_RGB if IDF_TARGET_ESP32C2
    default APP_END_DEVICE_LED_TYPE_GPIO if IDF_TARGET_ESP32
    default APP_END_DEVICE_LED_TYPE_WS2812

    config APP_END_DEVICE_LED_TYPE_GPIO
        bool "Single GPIO LED"

    config APP_END_DEVICE_LED_TYPE_RGB
        bool "Three-channel RGB LED"
        depends on IDF_TARGET_ESP32C2

    config APP_END_DEVICE_LED_TYPE_WS2812
        bool "WS2812 LED"

    config APP_END_DEVICE_LED_TYPE_NONE
        bool "No LED"
endchoice

config APP_END_DEVICE_LED_GPIO
    int "LED GPIO"
    default 5 if IDF_TARGET_ESP32
    default 38 if IDF_TARGET_ESP32S3
    default 8
    depends on APP_END_DEVICE_LED_TYPE_GPIO

config APP_END_DEVICE_WS2812_LED_GPIO
    int "WS2812 LED GPIO"
    default 27 if IDF_TARGET_ESP32C5
    default 8 if IDF_TARGET_ESP32C2 || IDF_TARGET_ESP32C3 || IDF_TARGET_ESP32C6 || IDF_TARGET_ESP32H2
    default 48 if IDF_TARGET_ESP32S3
    default 18
    depends on APP_END_DEVICE_LED_TYPE_WS2812

endmenu
```

## examples/matter/matter_controller/sdkconfig.defaults
```kconfig
CONFIG_IDF_TARGET="esp32s3"

CONFIG_ESPTOOLPY_FLASHSIZE_8MB=y

CONFIG_PARTITION_TABLE_CUSTOM=y
CONFIG_PARTITION_TABLE_FILENAME="partitions.csv"
CONFIG_PARTITION_TABLE_OFFSET=0x8000
CONFIG_PARTITION_TABLE_MD5=y

# Disable the DS peripheral support in demo
CONFIG_ESP_SECURE_CERT_DS_PERIPHERAL=n

# PSRAM
CONFIG_SPIRAM=y
CONFIG_SPIRAM_MODE_OCT=y
CONFIG_SPIRAM_SPEED_80M=y
CONFIG_SPIRAM_ALLOW_BSS_SEG_EXTERNAL_MEMORY=y
CONFIG_SPIRAM_RODATA=y
CONFIG_FREERTOS_SUPPORT_STATIC_ALLOCATION=y
CONFIG_FREERTOS_TASK_CREATE_ALLOW_EXT_MEM=y
CONFIG_NVS_ALLOCATE_CACHE_IN_SPIRAM=y
CONFIG_BT_ALLOCATION_FROM_SPIRAM_FIRST=y
CONFIG_BT_NIMBLE_MEM_ALLOC_MODE_EXTERNAL=y
CONFIG_MBEDTLS_EXTERNAL_MEM_ALLOC=y
CONFIG_ESP_MATTER_MEM_ALLOC_MODE_EXTERNAL=y
CONFIG_CHIP_MEM_ALLOC_MODE_EXTERNAL=y
CONFIG_RMAKER_MTCTL_MEMORY_ALLOCATION_PREFER_SPIRAM=y
CONFIG_RMAKER_MTCTL_MEMORY_REPORT_TASK_CREATE_FROM_SPIRAM=y

# Stack size
CONFIG_FREERTOS_TIMER_TASK_STACK_DEPTH=4096
CONFIG_ESP_SYSTEM_EVENT_TASK_STACK_SIZE=4096
CONFIG_ESP_MAIN_TASK_STACK_SIZE=8192

# Bluetooth
CONFIG_BT_ENABLED=y
CONFIG_BT_NIMBLE_ENABLED=y

# LwIP
CONFIG_LWIP_IPV6_AUTOCONFIG=y
CONFIG_LWIP_HOOK_IP6_ROUTE_DEFAULT=y
CONFIG_LWIP_HOOK_ND6_GET_GW_DEFAULT=y
CONFIG_LWIP_TCPIP_RECVMBOX_SIZE=32
CONFIG_LWIP_TCPIP_TASK_STACK_SIZE=4096
CONFIG_LWIP_UDP_RECVMBOX_SIZE=32
CONFIG_LWIP_IPV6_NUM_ADDRESSES=6

# MbedTLS
CONFIG_MBEDTLS_DYNAMIC_BUFFER=y
CONFIG_MBEDTLS_DYNAMIC_FREE_CONFIG_DATA=y
CONFIG_MBEDTLS_TLS_CLIENT_ONLY=y
CONFIG_MBEDTLS_HKDF_C=y

# MQTT
CONFIG_MQTT_USE_CUSTOM_CONFIG=y
CONFIG_MQTT_TASK_STACK_SIZE=8192

# ESP RainMaker
CONFIG_ESP_RMAKER_USER_ID_CHECK=y
CONFIG_ESP_RMAKER_ASSISTED_CLAIM=y
CONFIG_ESP_RMAKER_USE_NVS=y
CONFIG_APP_NETWORK_PROV_SHOW_QR=y

# If ESP-Insights is enabled, we need MQTT transport selected
# Takes out manual efforts to enable this option
CONFIG_ESP_INSIGHTS_TRANSPORT_MQTT=y

# Matter
CONFIG_CHIP_PROJECT_CONFIG="main/matter_project_config.h"
CONFIG_CHIP_TASK_STACK_SIZE=8192
CONFIG_CHIP_FACTORY_NAMESPACE_PARTITION_LABEL="fctry"
CONFIG_ENABLE_ESP32_FACTORY_DATA_PROVIDER=y
CONFIG_ENABLE_ESP32_DEVICE_INSTANCE_INFO_PROVIDER=y
CONFIG_ENABLE_ESP32_DEVICE_INFO_PROVIDER=y
CONFIG_SEC_CERT_DAC_PROVIDER=y
CONFIG_DEVICE_VENDOR_ID=0x131B
CONFIG_DEVICE_PRODUCT_ID=0x2
CONFIG_ENABLE_OTA_REQUESTOR=n
CONFIG_ENABLE_MATTER_OVER_THREAD=n
CONFIG_BUILD_CHIP_TESTS=n
CONFIG_ENABLE_CHIP_SHELL=y
CONFIG_ESP_MATTER_CONSOLE_TASK_STACK=4096

# Disable Matter over BLE
CONFIG_ENABLE_CHIPOBLE=n
CONFIG_USE_BLE_ONLY_FOR_COMMISSIONING=n

# Disable network commissioning driver
CONFIG_WIFI_NETWORK_COMMISSIONING_DRIVER=n
CONFIG_THREAD_NETWORK_COMMISSIONING_DRIVER=n

# Matter commissioning Window should be closed on starting
CONFIG_CHIP_ENABLE_PAIRING_AUTOSTART=n

# Matter controller
CONFIG_ESP_MATTER_ENABLE_MATTER_SERVER=n
CONFIG_ESP_MATTER_COMMISSIONER_ENABLE=n
CONFIG_ENABLE_CHIP_CONTROLLER_BUILD=y
CONFIG_ESP_MATTER_CONTROLLER_ENABLE=y
CONFIG_CUSTOM_OPERATIONAL_CREDS_ISSUER=y
CONFIG_MAX_EXCHANGE_CONTEXTS=40
CONFIG_ESP_MATTER_ATTRIBUTE_BUFFER_LARGEST=2560
CONFIG_RMAKER_MTCTL_TASK_STACK_SIZE=8192
```

## examples/matter/matter_controller/sdkconfig.defaults.otbr
```kconfig
# Use USB Jtag Console
CONFIG_ESP_CONSOLE_USB_SERIAL_JTAG=y

# PSRAM
CONFIG_SPIRAM_MODE_QUAD=y
CONFIG_OPENTHREAD_PLATFORM_MALLOC_CAP_SPIRAM=y
CONFIG_MDNS_MEMORY_ALLOC_SPIRAM=y
CONFIG_MDNS_TASK_CREATE_FROM_SPIRAM=y

# Openthread
CONFIG_OPENTHREAD_ENABLED=y
CONFIG_OPENTHREAD_BORDER_ROUTER=y
CONFIG_THREAD_TASK_STACK_SIZE=8192
CONFIG_OPENTHREAD_LOG_LEVEL_DYNAMIC=n
CONFIG_OPENTHREAD_LOG_LEVEL_NOTE=y
CONFIG_OPENTHREAD_CLI=y

# LwIP
CONFIG_LWIP_IPV6_FORWARD=y
CONFIG_LWIP_IPV6_NUM_ADDRESSES=12
CONFIG_LWIP_MULTICAST_PING=y
CONFIG_LWIP_NETIF_STATUS_CALLBACK=y
CONFIG_LWIP_HOOK_IP6_INPUT_CUSTOM=y
CONFIG_LWIP_HOOK_IP6_SELECT_SRC_ADDR_CUSTOM=y
CONFIG_LWIP_FORCE_ROUTER_FORWARDING=y

# MbedTLS
CONFIG_MBEDTLS_HARDWARE_AES=y
CONFIG_MBEDTLS_HARDWARE_MPI=y
CONFIG_MBEDTLS_HARDWARE_SHA=y
CONFIG_MBEDTLS_CMAC_C=y
CONFIG_MBEDTLS_KEY_EXCHANGE_ECJPAKE=y
CONFIG_MBEDTLS_ECJPAKE_C=y
CONFIG_MBEDTLS_SSL_PROTO_DTLS=y
CONFIG_MBEDTLS_HKDF_C=y

# mDNS platform
CONFIG_USE_MINIMAL_MDNS=n
CONFIG_MDNS_MULTIPLE_INSTANCE=y

# Matter
CONFIG_ENABLE_ROUTE_HOOK=n
```

## examples/matter/matter_controller_with_touchscreen/sdkconfig.defaults
```kconfig
CONFIG_IDF_TARGET="esp32s3"

CONFIG_ESP_DEFAULT_CPU_FREQ_MHZ_240=y
CONFIG_ESP32S3_INSTRUCTION_CACHE_32KB=y
CONFIG_ESP32S3_DATA_CACHE_64KB=y
CONFIG_ESP32S3_DATA_CACHE_LINE_64B=y

CONFIG_PARTITION_TABLE_CUSTOM=y
CONFIG_PARTITION_TABLE_FILENAME="partitions.csv"
CONFIG_PARTITION_TABLE_OFFSET=0x8000
CONFIG_PARTITION_TABLE_MD5=y

CONFIG_COMPILER_OPTIMIZATION_PERF=y

# Board manager
CONFIG_ESP_BOARD_MANAGER_AUTO_CONFIG_DEVICE_AND_PERIPHERAL=y

# Disable the DS peripheral support in demo
CONFIG_ESP_SECURE_CERT_DS_PERIPHERAL=n

# PSRAM
CONFIG_SPIRAM=y
CONFIG_SPIRAM_SPEED_80M=y
CONFIG_SPIRAM_XIP_FROM_PSRAM=y
CONFIG_SPIRAM_ALLOW_BSS_SEG_EXTERNAL_MEMORY=y
CONFIG_SPIRAM_RODATA=y
CONFIG_FREERTOS_SUPPORT_STATIC_ALLOCATION=y
CONFIG_FREERTOS_TASK_CREATE_ALLOW_EXT_MEM=y
CONFIG_NVS_ALLOCATE_CACHE_IN_SPIRAM=y
CONFIG_BT_ALLOCATION_FROM_SPIRAM_FIRST=y
CONFIG_BT_NIMBLE_MEM_ALLOC_MODE_EXTERNAL=y
CONFIG_MBEDTLS_EXTERNAL_MEM_ALLOC=y
CONFIG_ESP_MATTER_MEM_ALLOC_MODE_EXTERNAL=y
CONFIG_CHIP_MEM_ALLOC_MODE_EXTERNAL=y
CONFIG_RMAKER_MTCTL_MEMORY_ALLOCATION_PREFER_SPIRAM=y
CONFIG_RMAKER_MTCTL_MEMORY_REPORT_TASK_CREATE_FROM_SPIRAM=y

# FreeRTOS
CONFIG_FREERTOS_PLACE_FUNCTIONS_INTO_FLASH=y
CONFIG_FREERTOS_HZ=1000

# Stack size
CONFIG_FREERTOS_TIMER_TASK_STACK_DEPTH=4096
CONFIG_ESP_SYSTEM_EVENT_TASK_STACK_SIZE=4096
CONFIG_ESP_MAIN_TASK_STACK_SIZE=8192

# Bluetooth
CONFIG_BT_ENABLED=y
CONFIG_BT_NIMBLE_ENABLED=y

# LwIP
CONFIG_LWIP_IPV6_AUTOCONFIG=y
CONFIG_LWIP_HOOK_IP6_ROUTE_DEFAULT=y
CONFIG_LWIP_HOOK_ND6_GET_GW_DEFAULT=y
CONFIG_LWIP_TCPIP_RECVMBOX_SIZE=32
CONFIG_LWIP_TCPIP_TASK_STACK_SIZE=4096
CONFIG_LWIP_UDP_RECVMBOX_SIZE=32
CONFIG_LWIP_IPV6_NUM_ADDRESSES=6

# MbedTLS
CONFIG_MBEDTLS_DYNAMIC_BUFFER=y
CONFIG_MBEDTLS_DYNAMIC_FREE_CONFIG_DATA=y
CONFIG_MBEDTLS_TLS_CLIENT_ONLY=y
CONFIG_MBEDTLS_HKDF_C=y

# MQTT
CONFIG_MQTT_USE_CUSTOM_CONFIG=y
CONFIG_MQTT_TASK_STACK_SIZE=8192

# LVGL Generic
CONFIG_LV_BUILD_EXAMPLES=n
CONFIG_LV_BUILD_DEMOS=n
CONFIG_LV_COLOR_DEPTH_16=y
CONFIG_LV_FONT_FMT_TXT_LARGE=y
CONFIG_LV_FONT_MONTSERRAT_32=y
CONFIG_LV_USE_FONT_COMPRESSED=y
CONFIG_LV_USE_QRCODE=y

# LVGL Perf
CONFIG_LV_USE_CLIB_MALLOC=y
CONFIG_LV_USE_CLIB_STRING=y
CONFIG_LV_USE_CLIB_SPRINTF=y
CONFIG_LV_OBJ_STYLE_CACHE=y

# ESP RainMaker
CONFIG_ESP_RMAKER_USER_ID_CHECK=y
CONFIG_ESP_RMAKER_ASSISTED_CLAIM=y
CONFIG_ESP_RMAKER_USE_NVS=y
CONFIG_APP_NETWORK_PROV_SHOW_QR=n

# If ESP-Insights is enabled, we need MQTT transport selected
# Takes out manual efforts to enable this option
CONFIG_ESP_INSIGHTS_TRANSPORT_MQTT=y

# Matter
CONFIG_CHIP_PROJECT_CONFIG="main/matter_project_config.h"
CONFIG_CHIP_TASK_STACK_SIZE=8192
CONFIG_CHIP_FACTORY_NAMESPACE_PARTITION_LABEL="fctry"
CONFIG_ENABLE_ESP32_FACTORY_DATA_PROVIDER=y
CONFIG_ENABLE_ESP32_DEVICE_INSTANCE_INFO_PROVIDER=y
CONFIG_ENABLE_ESP32_DEVICE_INFO_PROVIDER=y
CONFIG_SEC_CERT_DAC_PROVIDER=y
CONFIG_DEVICE_VENDOR_ID=0x131B
CONFIG_DEVICE_PRODUCT_ID=0x2
CONFIG_ENABLE_OTA_REQUESTOR=n
CONFIG_ENABLE_MATTER_OVER_THREAD=n
CONFIG_BUILD_CHIP_TESTS=n
CONFIG_ENABLE_CHIP_SHELL=y
CONFIG_ESP_MATTER_CONSOLE_TASK_STACK=4096

# Disable Matter over BLE
CONFIG_ENABLE_CHIPOBLE=n
CONFIG_USE_BLE_ONLY_FOR_COMMISSIONING=n

# Disable network commissioning driver
CONFIG_WIFI_NETWORK_COMMISSIONING_DRIVER=n
CONFIG_THREAD_NETWORK_COMMISSIONING_DRIVER=n

# Matter commissioning Window should be closed on starting
CONFIG_CHIP_ENABLE_PAIRING_AUTOSTART=n

# Matter controller
CONFIG_ESP_MATTER_ENABLE_MATTER_SERVER=n
CONFIG_ESP_MATTER_COMMISSIONER_ENABLE=n
CONFIG_ENABLE_CHIP_CONTROLLER_BUILD=y
CONFIG_ESP_MATTER_CONTROLLER_ENABLE=y
CONFIG_CUSTOM_OPERATIONAL_CREDS_ISSUER=y
CONFIG_MAX_EXCHANGE_CONTEXTS=40
CONFIG_ESP_MATTER_ATTRIBUTE_BUFFER_LARGEST=2560
CONFIG_RMAKER_MTCTL_TASK_STACK_SIZE=8192
```
