## examples/common/rmaker_user_api/Kconfig
```kconfig
menu "RainMaker User API Configuration"

    config RM_USER_SUPPORT_REUSE_HTTP_SESSION
        bool "Support User HTTP Session Reuse"
        default y
        help
            Option to make User API reuse previous HTTP connection.
            This retains the User HTTP session with backend so that TLS handshake is not repeated.
            This speeds up operations, but has an impact on heap memory as the session will stay allocated.

    config ENABLE_RM_USER_HELPER_API
        bool "Enable helper RainMaker User API"
        default n
        help
            Enable helper C APIs for common User API handling so that creating the HTTP requests and parsing the responses can be avoided.
            Refer the header file for more info.

    config RM_USER_HTTP_TX_BUFFER_SIZE
        int "HTTP TX Buffer Size"
        range 2048 16384
        default 2048
        help
            Set the buffer size, in bytes, for the HTTP request line and headers,
            including the access token in the Authorization header.
            If the buffer is too small to hold them, every authenticated User API
            call fails with a timeout. Request bodies are written separately and
            are not limited by this buffer. Increase this value for longer access
            tokens, at the cost of higher heap usage per HTTP client.

endmenu
```

## examples/multi_device/sdkconfig.defaults.ble_session.esp32c3
```kconfig
# ESP32-C3: footprint trims so that a persistent BLE session and Wi-Fi fit in RAM together

# Bluetooth
CONFIG_BT_RELEASE_IRAM=y
CONFIG_BT_NIMBLE_MAX_CONNECTIONS=1
CONFIG_BT_NIMBLE_MAX_BONDS=2
CONFIG_BT_NIMBLE_MAX_CCCDS=2
CONFIG_BT_NIMBLE_MSYS_1_BLOCK_COUNT=10
CONFIG_BT_NIMBLE_MSYS_1_BLOCK_SIZE=100
CONFIG_BT_NIMBLE_MSYS_2_BLOCK_COUNT=4
CONFIG_BT_NIMBLE_ACL_BUF_COUNT=5
CONFIG_BT_NIMBLE_HCI_EVT_HI_BUF_COUNT=5
CONFIG_BT_NIMBLE_HCI_EVT_LO_BUF_COUNT=3
CONFIG_BT_NIMBLE_GATT_MAX_PROCS=1
CONFIG_BT_NIMBLE_ENABLE_CONN_REATTEMPT=n
CONFIG_BT_NIMBLE_50_FEATURE_SUPPORT=n

# SPI Configuration
CONFIG_SPI_MASTER_ISR_IN_IRAM=n
CONFIG_SPI_SLAVE_ISR_IN_IRAM=n

# Ethernet
CONFIG_ETH_USE_SPI_ETHERNET=n

# ESP Ringbuf
CONFIG_RINGBUF_PLACE_FUNCTIONS_INTO_FLASH=y
CONFIG_RINGBUF_PLACE_ISR_FUNCTIONS_INTO_FLASH=y

# ESP System Settings
CONFIG_ESP_SYSTEM_EVENT_QUEUE_SIZE=16
CONFIG_ESP_SYSTEM_EVENT_TASK_STACK_SIZE=2048
CONFIG_ESP_MAIN_TASK_STACK_SIZE=3072

# High resolution timer (esp_timer)
CONFIG_ESP_TIMER_TASK_STACK_SIZE=2048

# Wi-Fi
# SW coexistence stays enabled, because BT and Wi-Fi share the radio on C3
CONFIG_ESP_WIFI_ENABLE_WPA3_SAE=n
CONFIG_ESP_WIFI_ENABLE_WPA3_OWE_STA=n
CONFIG_ESP_WIFI_STA_DISCONNECTED_PM_ENABLE=n

# Hardware Abstraction Layer (HAL) and Low Level (LL)
CONFIG_HAL_ASSERTION_DISABLE=y

# LWIP
CONFIG_LWIP_TCPIP_RECVMBOX_SIZE=16
CONFIG_LWIP_DHCPS=n
CONFIG_LWIP_IPV6_AUTOCONFIG=y
CONFIG_LWIP_MAX_ACTIVE_TCP=5
CONFIG_LWIP_MAX_LISTENING_TCP=5
CONFIG_LWIP_TCP_HIGH_SPEED_RETRANSMISSION=n
CONFIG_LWIP_TCP_SYNMAXRTX=12
CONFIG_LWIP_TCP_MSL=40000
CONFIG_LWIP_TCP_FIN_WAIT_TIMEOUT=16000
CONFIG_LWIP_TCP_OVERSIZE_QUARTER_MSS=y
CONFIG_LWIP_TCP_RTO_TIME=1500
CONFIG_LWIP_MAX_UDP_PCBS=8
CONFIG_LWIP_HOOK_IP6_ROUTE_DEFAULT=y
CONFIG_LWIP_HOOK_ND6_GET_GW_DEFAULT=y

# Wear Levelling
CONFIG_WL_SECTOR_SIZE_512=y
```
